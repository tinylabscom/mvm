## examples/yocto/meta-mvm/conf/layer.conf
```bitbake
BBPATH .= ":${LAYERDIR}"
BBFILES += "${LAYERDIR}/recipes-*/*/*.bb"
BBFILE_COLLECTIONS += "mvm"
BBFILE_PATTERN_mvm = "^${LAYERDIR}/"
BBFILE_PRIORITY_mvm = "6"
LAYERSERIES_COMPAT_mvm = "scarthgap"
```
